// T32 Fri Jul 12 15:53:41 2019

B::

TOOLBAR   ON
STATUSBAR ON
FramePOS 22.75,13.0,,,Maximized
WinPAGE.RESet

WinPAGE.Create P000
WinCLEAR

WinPOS 0.0 0.0 100. 25. 0. 0. W000
area

WinPOS 1.875 1.0714 114. 26. 14. 1. W001
WinTABS 10. 10. 25. 62.
List.auto /CORE 2.

WinPOS 3.75 2.1429 114. 26. 14. 1. W002
WinTABS 10. 10. 25. 62.
List.auto /CORE 0.

WinPOS 15.0 8.5714 44. 30. 14. 1. W003
data.dump (0x010C0000) /DIALOG

WinPAGE.select P000

ENDDO
