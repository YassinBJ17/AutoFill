// T32_1000001 Thu Oct 24 11:41:45 2019

B::

TOOLBAR   ON
STATUSBAR ON
FramePOS 11.143,6.5,,,Maximized
WinPAGE.RESet

WinPAGE.Create P000
WinCLEAR

WinPOS 175.43 0.16667 38. 36. 0. 0. W002
Var.Watch


WinPOS 0.0 11.833 67. 5. 5. 0. W004
Frame

WinPOS 0.0 23.583 67. 25. 0. 1. W003
WinTABS 52. 26.
sYmbol.Browse.Function

WinPOS 71.857 43.0 142. 6. 24. 1. W001
WinTABS 13. 0. 0. 0. 0. 0. 0.
Break.List

WinPOS 0.0 0.0 67. 7. 0. 0. W000
area

WinPOS 71.857 0.25 98. 36. 14. 1. W005
WinTABS 10. 10. 25. 62.
List

WinPAGE.select P000

ENDDO
