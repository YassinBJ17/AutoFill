;------------------------------------------------------------------------------
;                     PROJECT : JDP_FADEX
;------------------------------------------------------------------------------
; SAFRAN ELECTRONICS DEFENSE Proprietary information
;------------------------------------------------------------------------------
; ENTITY BODY : 
;------------------------------------------------------------------------------
; HISTORY :
; | Version | Date       | Author       | see FFTL #
; |         |            |              |
; |         |            |              |
; |         |            |              |
; -----------------------------------------------------------------------------
; COMMENT:
; - Script functionnality limited to single core
; -----------------------------------------------------------------------------

; -----------------------------------------------------------------------------
; Global variables
; -----------------------------------------------------------------------------
GLOBAL &ERASE_FLASH &LIST_TO_FLASH &LIST_TO_LOAD &LOAD_LOCAL

; -----------------------------------------------------------------------------
; Prepare Trace32 environment
; -----------------------------------------------------------------------------
;do window

; -----------------------------------------------------------------------------
; Prepare executable Path
; -----------------------------------------------------------------------------
&current_dir=OS.PPD()
&root_project_dir=OS.FILE.ABSPATH("&current_dir/../../")
&ElfBootRootPATH=OS.FILE.ABSPATH("&root_project_dir/3_Sources/BOOT_code/build/BOOT.elf")
&ElfBootABSRootPATH=OS.FILE.ABSPATH("&root_project_dir/3_Sources/BOOT_code/build/BOOT.abs")

; -----------------------------------------------------------------------------
; Prepare source Path
; -----------------------------------------------------------------------------
&T32_SOURCE_BOOT=OS.FILE.ABSPATH("&root_project_dir/3_Sources/BOOT_code/sources/")

; -----------------------------------------------------------------------------
; Prepare List to Flash and List to load
; -----------------------------------------------------------------------------

RESet
area
DO ~~/demo/powerpc/flash/jpc577xm.cmm PREPAREONLY

SYMBOL.RESET
print "RESET"
FLASH.ReProgram
FLASH.AUTO 1.
FLASH.AUTO 2.
FLASH.AUTO 3.
FLASH.AUTO 4.
FLASH.AUTO 6.

Data.LOAD.ELF "&ElfBootRootPATH" /STRIPPATH /NOCLEAR
Data.LOAD.auto &ElfBootABSRootPATH /STRIPPATH /NOCLEAR


print "Programming Flash"
FLASH.ReProgram OFF



; -----------------------------------------------------------------------------
; Prepare Trace 32 CPU attaching
; -----------------------------------------------------------------------------
; CPU setup

SYStem.RESet                    
SYStem.BdmClock 4.0MHz
SYStem.CPU MPC5777M             ; set Matterhorn
SYSTEM.CONFIG.CORENUMBER 3. ;set up the number of cores you want
CORE.ASSIGN 1. 2. 3.
SYStem.CONFIG.CORE 3. 1.        ; Connect to Core2
SYStem.Option.WATCHDOG OFF
;SYStem.CONFIG.TAPState 12.      ; Neutral parking position (Run-Test/Idle)
SYStem.UP
System.Option ResetMode FUNCtional

; BAF configures only SWT2 as security watchdog for the CPU2 (IOP) core.
; SWT2 is Soft locked: writing 2 keys sequence to unlock and disable

D.S e:0xFC058010 %be %LONG 0xC520
D.S e:0xFC058010 %be %LONG 0xD928
D.S e:0xFC058000 %be %LONG 0xFF000000       ; SWT2_CR
;Enable system access to allow raeding of memory in real time 
SYS.CpuAccess.E
; -----------------------------------------------------------------------------
; Prepare Trace 32 Trace configuration
; -----------------------------------------------------------------------------
IF !POWERTRACE()
(
  IF CHIP.EmulationDevice()
    Onchip.TBARange EEC:0xC000000--0xC1FFFFF
  ELSE
    Onchip.TBARange A:0x0D000000--0x0D003FFF

  Trace.METHOD Onchip
  Trace.Init
)
IF POWERTRACE()&&!POWERNEXUS()
(
  NEXUS.PortSize 4Lane
  NEXUS.PortMode 1250Mbps
  NEXUS.RefClock ON
)

TrOnchip.EDBRAC0 0x40000108 ; Give PMR ownership to target

; -----------------------------------------------------------------------------
; Prepare Trace 32 Source path
; -----------------------------------------------------------------------------
SYMBOL.SPATH.SETRECURSEDIR &T32_SOURCE_BOOT
mode.hll

SETUP.StepAllCores ON
List.auto /CORE 2.

; -----------------------------------------------------------------------------
; Breakpoints to configure EBI
; -----------------------------------------------------------------------------
;Break.Set     BOOT_MAIN_INIT+0x68 /Program
;GO
;do bkpts.cmm

;go
;wait 200.ms
;SYStem.Attach
;break


ENDDO

