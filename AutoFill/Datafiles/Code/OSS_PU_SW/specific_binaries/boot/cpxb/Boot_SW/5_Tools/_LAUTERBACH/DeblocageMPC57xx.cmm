; --------------------------------------------------------------------------------
; @Title: 
;
; @Description: -
; @Author: 
; @Chip: MPC5777M
; @Copyright: (C) 1989-2014 Lauterbach GmbH, licensed for use with TRACE32(R) only
; --------------------------------------------------------------------------------
   SYSTEM.RESET
   SYSTEM.BDMCLOCK 4.0MHz
   SYSTEM.CPU MPC5777M
   SYSTEM.CONFIG.CORE 3. 1.
   SYSTEM.CONFIG.SLAVE OFF
   SYSTEM.OPTION.WATCHDOG OFF

   DO ~~/demo/powerpc/etc/standby/haltatpoweronreset.cmm

   SYSTEM.UP
