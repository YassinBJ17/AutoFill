// T32 Tue Jul  2 14:15:10 2019

B::

BREAK.RESET
BREAK.SET     BOOT_RESET_CORE_0 /Program
BREAK.SET     BOOT_RESET_CORE_1 /Program
BREAK.SET     BOOT_RESET_CORE_2 /Program

ENDDO
