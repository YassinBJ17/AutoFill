// t32 Tue May 05 15:23:36 2015

 B::

 BREAK.RESET
 B.S   COVM_VM_REBOOT /P
 B.S   COVM_VM_SHUTDOWN /P
 B.S   HALEX_SCTRL_HARD_RESET /P
 B.S   HALEX_SCTRL_SHUTDOWN /P
 B.S   HALEX_SCTRL_SOFT_RESET /P
 B.S   LIBT_CTRL_UNEXPECTED_BEHAVIOR /P
 B.S   LIBT_CTRL_HAPPY_END /P

 ENDDO
