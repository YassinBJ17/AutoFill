;------------------------------------------------------------------------------
;                     PROJECT : S3P
;------------------------------------------------------------------------------
; SAFRAN ELECTRONICS & DEFENSE Proprietary information
;------------------------------------------------------------------------------
; ENTITY BODY : Trace32 script
;------------------------------------------------------------------------------
; HISTORY :
; | Version | Date       | Author       | see FFTL #
; | initial |            |              | Creation
; |         |            |              |
; |         |            |              |
; -----------------------------------------------------------------------------

ENTRY &file &start &offset

LOCAL &flash_program
LOCAL &file_name

&file_name=OS.FILE.NAME(&file)
&flash_program="FALSE"

IF "&CONF_TGT_MODE"=="TARGET"
(
   IF ("&CONF_TGT_NAME"=="PROJ_GEN")||("&CONF_TGT_NAME"=="FADEX"||("&CONF_TGT_NAME"=="M88")||("&CONF_TGT_NAME"=="COBRA")
   (
      &flash_program="TRUE"
   )
)


IF "&flash_program"=="TRUE"
(
   IF hardware.ICD()
   (
      DIALOG.YESNO "Load &file_name in flash ?"
      LOCAL &progflash
      ENTRY &progflash
      IF &progflash
      (
         ; START OF PROGRAMMING
         DO &T32_GLBCMM/&CONF_TGT_NAME/TGT/init_flash.cmm PREPAREONLY SKIPCONFIG
         FLASH.ReProgram
         FLASH.AUTO 1.
         FLASH.AUTO 4.
         FLASH.AUTO 5.
         FLASH.AUTO 6.
         FLASH.AUTO 7.
         FLASH.AUTO 8.
         FLASH.AUTO 9.
         FLASH.AUTO 10.
         FLASH.AUTO 11.
         FLASH.AUTO 12.
         FLASH.AUTO 13.
         FLASH.AUTO 14.
         FLASH.AUTO 15.

         ; LOAD FILE
         Data.LOAD.binary &file &start++&offset /LONGSWAP /STRIPPATH /NOCLEAR
         ; END OF PROGRAMMING
         FLASH.ReProgram.off
      )
      ELSE
      (
         ; LOAD FILE
         Data.LOAD.binary &file &start++&offset /LONGSWAP /STRIPPATH /NOCODE /NOCLEAR
      )
   )
   ELSE
   (
      ; LOAD FILE
      Data.LOAD.binary &file &start++&offset /LONGSWAP /STRIPPATH /NOCODE /NOCLEAR
   )
)
ELSE
(
   ; LOAD FILE
   Data.LOAD.binary &file &start++&offset /LONGSWAP /STRIPPATH /NOCLEAR
)
