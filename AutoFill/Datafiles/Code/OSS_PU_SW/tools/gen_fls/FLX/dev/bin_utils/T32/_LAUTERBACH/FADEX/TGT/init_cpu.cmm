;------------------------------------------------------------------------------
;                     PROJECT : S3P
;------------------------------------------------------------------------------
; SAFRAN ELECTRONICS & DEFENSE Proprietary information
;------------------------------------------------------------------------------
; ENTITY BODY : Trace32 script
;------------------------------------------------------------------------------
; HISTORY :
; | Version | Date       | Author       | see FFTL #
; | initial |            |              | Creation
; |         |            |              |
; |         |            |              |
; -----------------------------------------------------------------------------

; -----------------------------------------------------------------------------
;       Protection Support Configuration
; -----------------------------------------------------------------------------
; NONE

; -----------------------------------------------------------------------------
;       Special Registers Configuration
; -----------------------------------------------------------------------------
; NONE

; -----------------------------------------------------------------------------
;       GPRs Configuration
; -----------------------------------------------------------------------------
; NONE

; End of Script
ENDDO

