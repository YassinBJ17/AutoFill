;------------------------------------------------------------------------------
;                     PROJECT : S3P
;------------------------------------------------------------------------------
; SAFRAN ELECTRONICS & DEFENSE Proprietary information
;------------------------------------------------------------------------------
; ENTITY BODY : Trace32 script
;------------------------------------------------------------------------------
; HISTORY :
; | Version | Date       | Author       | see FFTL #
; | initial |            |              | Creation
; |         |            |              |
; |         |            |              |
; -----------------------------------------------------------------------------

; get arguments
ENTRY &arg_debug_mode &arg_cpu_control

; -----------------------------------------------------------------------------
;    Set Trace 32 CPU environnement and Probe configuration
; -----------------------------------------------------------------------------

SYSTEM.RESET

SYSTEM.BDMCLOCK 4MHz

;settings for JTAG debugger / simulator
IF SIMULATOR()
   SYSTEM.CPU MPC5777M
ELSE
(
   ;SYSTEM.DETECT.CPU
   SYSTEM.CPU MPC5777M
   SYSTEM.CONFIG.CORENUMBER 3. ;set up the number of cores you want
   ;CORE.NUMBER 3              ;TRACE32 to connect to (SMP system)
   ;SYSTEM.CONFIG.CORE 3. 1.   ; to inform the TRACE32 instance which core/chip it controls for debugging
   ;SYSTEM.CONFIG.SLAVE OFF
   SYSTEM.OPTION.WATCHDOG OFF
)

SYSTEM.MEMACCESS DENIED    ;Default : DENIED
SYSTEM.CPUACCESS DENIED    ;Default : DENIED
SYSTEM.OPTION IMASKASM OFF ;Default : OFF
SYSTEM.OPTION IMASKHLL OFF ;Default : OFF
SYSTEM.OPTION DISMODE VLE  ; allows to display the code correctly when VLE mode is not activated

; CPU control ?
IF "&arg_cpu_control"=="CPU_2"
(
   PRINT " Probe controls CPU_2 : CORE_IO"
   SYSTEM.CONFIG.CORE 3. 1.   ; to inform the TRACE32 instance which core/chip it controls for debugging
   ; Control CPU 2
   CORE.ASSIGN 3.
)
ELSE
(
   IF "&arg_cpu_control"=="CPU_1"
   (
      PRINT " Probe controls CPU_1 : CORE_1"
      SYSTEM.CONFIG.CORE 2. 1.   ; to inform the TRACE32 instance which core/chip it controls for debugging
      ; Control CPU 1
      CORE.ASSIGN 2.
   )
   ELSE
   (
      IF "&arg_cpu_control"=="CPU_0"
      (
         PRINT " Probe controls CPU_0 : CORE_0"
         SYSTEM.CONFIG.CORE 1. 1.   ; to inform the TRACE32 instance which core/chip it controls for debugging
         ; Control CPU 0
         CORE.ASSIGN 1.
      )
      ELSE
      (
         IF "&arg_cpu_control"=="CPU_ALL"
         (
            PRINT " Probe controls all CPUs"
            SYSTEM.CONFIG.CORE 3. 1.
            ; Control all CPUs
            CORE.ASSIGN 1. 2. 3.
         )
         ELSE
         (
            PRINT "STOP Error: UNSUPPORTED CPU_CONTROL in init_probe.cmm second parameter. CPU_2, CPU_1, CPU_0, CPU_ALL"
            STOP
         )
      )
   )
)


; Debug Mode ?
IF "&arg_debug_mode"=="DEBUG_ON"
(
   ; TODO
)
ELSE
(
   ; TODO
)


; -----------------------------------------------------------------------------
;    Set Trace 32 ETM Probe configuration
; -----------------------------------------------------------------------------
; Note ETM trace only one core at a time
; To change traced core change funnel configuration

IF SIMULATOR()
(
   Trace.METHOD Analyzer
   Trace.Init
)

IF POWERTRACE()&&!POWERNEXUS()
(
   NEXUS.PortSize 4Lane
   NEXUS.PortMode 1250Mbps
   NEXUS.RefClock ON
)


; -----------------------------------------------------------------------------
;    SYSTEM is ready
; -----------------------------------------------------------------------------
IF "&arg_cpu_control"=="CPU_0"
(
   ;SYStem.Mode.noDebug
   SYSTEM.MODE.ATTACH
)
ELSE
(
   SYSTEM.UP
)

; End Of Script
ENDDO
