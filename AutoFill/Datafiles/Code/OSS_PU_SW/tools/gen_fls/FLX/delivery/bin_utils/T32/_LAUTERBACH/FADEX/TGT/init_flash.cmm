;
; copy from demo\powerpc\flash\mpc5xxx.cmm
;

;get parameters
LOCAL &parameters &param_skipconfig &current_dir
ENTRY %LINE &parameters
&param_skipconfig=(STRing.SCAN(STRing.UPpeR("&parameters"),"SKIPCONFIG",0)!=-1)

IF SIMULATOR()
(
  DIALOG.OK "Flash programming not possible on simulator."
  ENDDO
)

IF !&param_skipconfig
(
  ON.ERROR GOTO failed
  SYStem.Down
  SYStem.CPU MPC55XX
  SYStem.DETECT.CPU
failed:
)


&current_dir=OS.PPD()
&T32_FLHLOCCMM="&current_dir"
LOCAL &flashscript
&flashscript="&T32_FLHLOCCMM"+"/"+"flash.cmm"


IF !FILE.EXIST("&flashscript")
(
  DIALOG.OK "Flash script &flashscript could not be found."
  ENDDO
)

DO "&flashscript" &parameters

ENDDO
