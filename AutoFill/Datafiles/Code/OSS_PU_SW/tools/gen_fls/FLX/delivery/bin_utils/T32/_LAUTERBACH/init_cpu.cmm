;------------------------------------------------------------------------------
;                     PROJECT : S3P
;------------------------------------------------------------------------------
; SAFRAN ELECTRONICS & DEFENSE Proprietary information
;------------------------------------------------------------------------------
; ENTITY BODY : Trace32 script
;------------------------------------------------------------------------------
; HISTORY :
; | Version | Date       | Author       | see FFTL #
; | initial |            |              | Creation
; |         |            |              |
; |         |            |              |
; -----------------------------------------------------------------------------

; prevent path problems
LOCAL &current_dir
&current_dir=OS.PPD()


; According to the target
IF "&CONF_TGT_NAME"=="PROJ_GEN"
(
   IF "&CONF_TGT_MODE"=="TARGET"
   (
      ; Initialize the CPU on target mode
      DO &current_dir/PROJ_GEN/TGT/init_cpu.cmm
   )
   ELSE
   (
      ; Unsupported type
      PRINT "UNSUPPORTED TARGET TYPE : &CONF_TGT_MODE on &CONF_TGT_NAME"
      STOP
   )
)
ELSE IF "&CONF_TGT_NAME"=="FADEX"
(
   IF "&CONF_TGT_MODE"=="TARGET"
   (
      ; Initialize the CPU on target mode
      DO &current_dir/FADEX/TGT/init_cpu.cmm
   )
   ELSE
   (
      ; Unsupported type
      PRINT "UNSUPPORTED TARGET TYPE : &CONF_TGT_MODE on &CONF_TGT_NAME"
      STOP
   )
)
ELSE IF "&CONF_TGT_NAME"=="M88"
(
   IF "&CONF_TGT_MODE"=="TARGET"
   (
      ; Initialize the CPU on target mode
      DO &current_dir/M88/TGT/init_cpu.cmm
   )
   ELSE
   (
      ; Unsupported type
      PRINT "UNSUPPORTED TARGET TYPE : &CONF_TGT_MODE on &CONF_TGT_NAME"
      STOP
   )
)
ELSE IF "&CONF_TGT_NAME"=="COBRA"
(
   IF "&CONF_TGT_MODE"=="TARGET"
   (
      ; Initialize the CPU on target mode
      DO &current_dir/COBRA/TGT/init_cpu.cmm
   )
   ELSE
   (
      ; Unsupported type
      PRINT "UNSUPPORTED TARGET TYPE : &CONF_TGT_MODE on &CONF_TGT_NAME"
      STOP
   )
)
ELSE
(
   ; Unsupported target
   PRINT "UNSUPPORTED TARGET : &CONF_TGT_NAME"
   STOP
)


; End Of Script
ENDDO


