// T32 Thu Feb 12 16:14:00 2015

 B::
 
 TOOLBAR ON
 STATUSBAR ON
 FramePOS 14.625,5.8571,,,Maximized
 WinPAGE.RESet
 
 WinPAGE.Create TMES
 
 WinCLEAR
 WinPOS 150.75 0.0 54. 29. 0. 0. W000
 Register /SPOTLIGHT 
 
 WinPOS 100.5 0.0 46. 29. 0. 0. W002
 Var.View %open RTC_CTRLER_PT
 
 WinPOS 100.63 33.214 104. 22. 25. 1. W003
 WinTABS 13. 16. 0. 0. 0. 0. 0.
 Break.List
 
 WinPOS 0.0 32.786 96. 22. 0. 0. W001
 Var.Watch
 
 VAR.ADDWATCH CPSP_TIMER_descr_tab
 
 WinPOS 156.88 0.071429 48. 30. 0. 0. W051
 Register
 
 WinPOS 97.25 0.0 55. 28. 5. 0. W052
 Var.Frame /Locals /Caller
 
 WinPOS 0.0 0.0 96. 28. 15. 1. W004
 WinTABS 10. 21. 25. 62.
 Data.List
 
 WinPAGE.Create IRQS
 
 WinCLEAR
 WinPOS 0.0 0.0 101. 27. 15. 1. W008
 WinTABS 10. 10. 25. 62.
 Data.List
 
 WinPOS 155.63 0.0 49. 29. 0. 0. W006
 Register /SPOTLIGHT 
 
 WinPOS 105.38 0.0 46. 29. 0. 0. W005
 Var.View %open CPSP_IRQ_HSI_ctrler_pt
 
 WinPOS 0.125 32.857 101. 22. 0. 0. W007
 Var.Watch
 
 VAR.ADDWATCH CPSP_IRQ_descr_tab
 
 WinPOS 105.63 33.0 99. 22. 26. 1. W042
 WinTABS 13. 0. 0. 0. 0. 0. 0.
 Break.List
 
 WinPAGE.Create PRTS
 
 WinCLEAR
 WinPOS 0.0 0.0 97. 28. 15. 1. W012
 WinTABS 10. 10. 25. 62.
 Data.List
 
 WinPOS 156.75 0.071429 48. 30. 0. 0. W011
 Register
 
 WinPOS 0.0 33.5 98. 22. 0. 0. W010
 Var.Watch
 
 VAR.ADDWATCH CPSP_PROT_ctx_descr_tab
 VAR.ADDWATCH ctx_attr
 
 WinPOS 102.25 32.929 103. 24. 0. 0. W009
 per , "System Control"
 WinPAN 0. 30.
 
 WinPAGE.Create EVT
 
 WinCLEAR
 WinPOS 0.0 0.0 102. 27. 15. 1. W014
 WinTABS 10. 10. 25. 62.
 Data.List
 
 WinPOS 157.0 0.0 48. 29. 0. 0. W013
 Register
 
 WinPOS 105.25 0.0 48. 27. 5. 0. W016
 Var.Frame /Locals /Caller
 
 WinPOS 0.0 32.714 103. 23. 0. 0. W015
 Var.Watch
 
 VAR.ADDWATCH COVM_EVENT_descr_tab
 VAR.ADDWATCH COVM_EVENT_nb
 
 WinPOS 107.5 32.857 97. 23. 26. 1. W043
 WinTABS 13. 0. 0. 0. 0. 0. 0.
 Break.List
 
 WinPAGE.Create STK
 
 WinCLEAR
 WinPOS 0.0 0.0 102. 27. 15. 1. W018
 WinTABS 10. 10. 25. 62.
 Data.List
 
 WinPOS 157.0 0.0 48. 29. 0. 0. W017
 Register
 
 WinPOS 0.0 32.714 102. 23. 0. 0. W019
 Var.Watch
 
 VAR.ADDWATCH COVM_STACK_descr_tab
 
 WinPOS 106.63 0.0 47. 27. 5. 0. W020
 Var.Frame /Locals /Caller
 
 WinPOS 106.5 32.429 98. 23. 26. 1. W044
 WinTABS 13. 0. 0. 0. 0. 0. 0.
 Break.List
 
 WinPAGE.Create THRD
 
 WinCLEAR
 WinPOS 0.0 0.0 102. 27. 15. 1. W022
 WinTABS 10. 10. 25. 62.
 Data.List
 
 WinPOS 156.88 0.0 48. 29. 0. 0. W021
 Register
 
 WinPOS 0.0 32.714 102. 23. 0. 0. W023
 Var.Watch
 
 VAR.ADDWATCH COVM_THRD_vm_tab
 VAR.ADDWATCH COVM_THRD_current_pt
 
 WinPOS 106.5 0.0 46. 27. 5. 0. W024
 Var.Frame /Locals /Caller
 
 WinPOS 106.0 32.714 99. 23. 26. 1. W045
 WinTABS 13. 0. 0. 0. 0. 0. 0.
 Break.List
 
 WinPAGE.Create VM
 
 WinCLEAR
 WinPOS 156.88 0.0 48. 29. 0. 0. W034
 Register /SPOTLIGHT
 
 WinPOS 106.5 0.0 46. 27. 5. 0. W028
 Var.Frame /Locals /Caller
 
 WinPOS 0.0 32.714 102. 23. 0. 0. W027
 Var.Watch
 
 VAR.ADDWATCH COVM_THRD_current_pt
 VAR.ADDWATCH COVM_THRD_vm_tab
 
 WinPOS 0.0 0.0 102. 27. 15. 1. W026
 WinTABS 10. 18. 25. 62.
 Data.List
 
 WinPOS 106.38 32.929 102. 22. 25. 1. W038
 WinTABS 13. 16. 0. 0. 20. 0. 0.
 Break.List
 
 WinPAGE.Create TMR
 
 WinCLEAR
 WinPOS 52.5 30.0 80. 25. 16. 1. W049 ICONIC
 WinTABS 10. 10. 25. 62.
 List T:0x20001218
 
 WinPOS 156.25 0.0 49. 34. 0. 0. W029
 Register
 
 WinPOS 103.38 0.0 49. 32. 5. 0. W030
 Var.Frame /Locals /Caller
 
 WinPOS 102.38 3.5 80. 25. 16. 1. W050
 WinTABS 10. 10. 25. 62.
 List T:0x20041218
 
 WinPOS 106.75 38.071 98. 17. 26. 1. W046
 WinTABS 13. 0. 0. 0. 0. 0. 0.
 Break.List
 
 WinPOS 0.0 0.0 102. 33. 15. 1. W032
 WinTABS 10. 10. 25. 62.
 Data.List
 
 WinPOS 0.0 38.857 102. 16. 0. 0. W031
 Var.Watch
 
 VAR.ADDWATCH COVM_TIME_scheme_tab
 VAR.ADDWATCH COVM_TIME_tickOS
 
 WinPAGE.Create SIG
 
 WinCLEAR
 WinPOS 0.0 32.786 103. 23. 0. 0. W036
 Var.Watch
 
 VAR.ADDWATCH COVM_SIG_vm_tab
 
 WinPOS 157.0 0.0 48. 29. 0. 0. W025
 Register
 
 WinPOS 0.0 0.071429 103. 27. 16. 1. W033
 WinTABS 10. 10. 25. 62.
 Data.List
 
 WinPOS 105.63 0.0 48. 27. 5. 0. W035
 Var.Frame /Locals /Caller
 
 WinPOS 107.5 33.143 97. 22. 26. 1. W047
 WinTABS 13. 0. 0. 0. 0. 0. 0.
 Break.List
 
 WinPAGE.Create MEM
 
 WinCLEAR
 WinPOS 186.88 0.0 48. 30. 0. 0. W053
 Register
 
 WinPOS 84.5 34.0 99. 12. 26. 1. W057
 WinTABS 13. 16. 0. 0. 0. 0. 0.
 Break.List
 
 WinPOS 84.75 47.643 99. 10. 0. 1. W058
 sYmbol.SPATH.List
 
 WinPOS 111.13 0.0 72. 28. 5. 0. W055
 Var.Frame /Locals /Caller
 
 WinPOS 113.13 15.429 81. 25. 16. 1. W060
 Data.dump v.address("*COVM_TIME_current_scheme_pt") /DIALOG /SPOTLIGHT
 
 WinPOS 0.0 0.0 107. 28. 16. 1. W054
 WinTABS 10. 10. 25. 62.
 Data.List
 
 WinPOS 28.125 15.286 80. 42. 0. 0. W056
 Var.Watch
 
 VAR.ADDWATCH \\TEST_CRTE_vm1\Global\CRTE_PROC_nb
 VAR.ADDWATCH \\TEST_CRTE_vm1\Global\CRTE_SCHED_descr_tab
 VAR.ADDWATCH sched_descr_pt
 VAR.ADDWATCH CRTE_PROC_current_pt
 VAR.ADDWATCH LIBT_CTRL_DESCR_PT
 VAR.ADDWATCH LIBT_REC_LOG_PT
 VAR.ADDWATCH COVM_TIME_current_scheme_pt
 VAR.ADDWATCH CPSP_IRQ_HSI_ctrler_pt
 VAR.ADDWATCH CPSP_TIMER_HSI_rtc_ctrler_pt
 
 WinPAGE.Create CRTE
 
 WinCLEAR
 WinPOS 157.88 0.0 47. 28. 0. 0. W040
 Register
 
 WinPOS 110.88 32.357 94. 6. 26. 1. W048
 WinTABS 13. 16. 0. 0. 0. 0. 0.
 Break.List
 
 WinPOS 105.5 0.0 48. 27. 5. 0. W041
 Var.Frame /Locals /Caller
 
 WinPOS 0.0 0.071429 102. 27. 16. 1. W037
 WinTABS 10. 17. 25. 62.
 Data.List
 
 WinPOS 0.0 32.571 107. 22. 0. 0. W039
 Var.Watch
 
 VAR.ADDWATCH COVM_MEM_vm_tab
 VAR.ADDWATCH arg_pt->mem_name
 
 WinPAGE.select MEM
 
 ENDDO
