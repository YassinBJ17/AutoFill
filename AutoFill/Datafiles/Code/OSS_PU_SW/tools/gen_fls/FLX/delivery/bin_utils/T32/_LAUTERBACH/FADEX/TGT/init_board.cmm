;------------------------------------------------------------------------------
;                     PROJECT : S3P
;------------------------------------------------------------------------------
; SAFRAN ELECTRONICS & DEFENSE Proprietary information
;------------------------------------------------------------------------------
; ENTITY BODY : Trace32 script
;------------------------------------------------------------------------------
; HISTORY :
; | Version | Date       | Author       | see FFTL #
; | initial |            |              | Creation
; |         |            |              |
; |         |            |              |
; -----------------------------------------------------------------------------

; prevent path problems
LOCAL &current_dir
&current_dir=OS.PPD()

; -----------------------------------------------------------------------------
;       Hardware Reset
; -----------------------------------------------------------------------------
;  -> Does NOT work yet

; -----------------------------------------------------------------------------
;       Protection Support Configuration
; -----------------------------------------------------------------------------
; Performed by boot software

; -----------------------------------------------------------------------------
;       PLL controller Configuration
; -----------------------------------------------------------------------------
; Performed by boot software

; -----------------------------------------------------------------------------
;       SRAM memory controler Configuration
; -----------------------------------------------------------------------------
;Default Value.

; -----------------------------------------------------------------------------
;       Internal memory Configuration
; -----------------------------------------------------------------------------


IF (("&CPU_CONTROL"=="CPU_0")||("&CPU_CONTROL"=="CPU_ALL"))
(
   ;initialize internal Processor Core Local SRAM
   ; I_MEM CPU_0
   Data.Set A:0x50000000--0x500003FF %Quad 0x55AA55AA55AA55AA
   ; D_MEM CPU_0
   Data.Set A:0x50800000--0x5080FFFF %Quad 0x55AA55AA55AA55AA
)

IF (("&CPU_CONTROL"=="CPU_1")||("&CPU_CONTROL"=="CPU_ALL"))
(
   ; I_MEM CPU_1
   Data.Set A:0x51000000--0x510003FF %Quad 0x55AA55AA55AA55AA
   ; D_MEM CPU_1
   Data.Set A:0x51800000--0x5180FFFF %Quad 0x55AA55AA55AA55AA
)

IF (("&CPU_CONTROL"=="CPU_2")||("&CPU_CONTROL"=="CPU_ALL"))
(
   ; I_MEM CPU_2
   Data.Set A:0x52000000--0x520003FF %Quad 0x55AA55AA55AA55AA
   ; D_MEM CPU_2
   Data.Set A:0x52800000--0x5280FFFF %Quad 0x55AA55AA55AA55AA
)    

IF (("&CPU_CONTROL"=="CPU_ALL")||("&CPU_CONTROL"=="CPU_0")||("&CPU_CONTROL"=="CPU_1")||("&CPU_CONTROL"=="CPU_2"))
(
   ;initialize internal System SRAM
   Data.Set A:0x40000000--0x40064FFF %Quad 0x55AA55AA55AA55AA
)


; End Of Script
ENDDO