;------------------------------------------------------------------------------
;                     PROJECT : S3P
;------------------------------------------------------------------------------
; SAFRAN ELECTRONICS & DEFENSE Proprietary information
;------------------------------------------------------------------------------
; ENTITY BODY : Trace32 configuration script
;------------------------------------------------------------------------------
; HISTORY :
; | Version | Date       | Author       | see FFTL #
; | initial |            |              | Creation
; |         |            |              |
; |         |            |              |
; -----------------------------------------------------------------------------

; make sure we use hexadecimal values by default
RADIX.HEX

; Declare global
GLOBAL &CONF_TGT_NAME
GLOBAL &CONF_TGT_EXE
GLOBAL &CONF_TGT_MODE
GLOBAL &CONF_ETM_PROBE
GLOBAL &AMP_MODE
GLOBAL &NC_MODE
GLOBAL &PROF_MODE
GLOBAL &CCDL_MODE

;-------------------------;
; CONF_TGT_EXE
;-------------------------;
; Supported EXE : "t32mppc"

&CONF_TGT_EXE="t32mppc"

;-------------------------;
; CONF_TGT_NAME
;-------------------------;
; Supported TARGETS : "FADEX", "M88", "COBRA", "PROJ_GEN"

&CONF_TGT_NAME="FADEX"

;-------------------------;
; CONF_TGT_MODE
;-------------------------;
; Supported TARGET MODE : "TARGET"

&CONF_TGT_MODE="TARGET"


;-------------------------;
; CONF_ETM_PROBE
;-------------------------;
; Supported TARGET : "ENABLED", "DISABLED"

&CONF_ETM_PROBE="DISABLED"


; End Of Script
ENDDO


