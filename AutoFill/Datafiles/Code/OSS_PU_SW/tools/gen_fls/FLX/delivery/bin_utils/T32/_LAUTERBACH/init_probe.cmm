;------------------------------------------------------------------------------
;                     PROJECT : S3P
;------------------------------------------------------------------------------
; SAFRAN ELECTRONICS & DEFENSE Proprietary information
;------------------------------------------------------------------------------
; ENTITY BODY : Trace32 script
;------------------------------------------------------------------------------
; HISTORY :
; | Version | Date       | Author       | see FFTL #
; | initial |            |              | Creation
; |         |            |              |
; |         |            |              |
; -----------------------------------------------------------------------------

; GLOBAL VARIABLE
GLOBAL &CPU_CONTROL


; check arguments
ENTRY &arg_debug_mode &arg_cpu_control

IF "&arg_debug_mode"=="DEBUG_ON"
(
   PRINT "Probe initialization with DEBUG_MODE_ON"
)
ELSE
(
   IF "&arg_debug_mode"=="DEBUG_OFF"
   (
      PRINT "Probe initialization with DEBUG_OFF"
   )
   ELSE
   (
      PRINT "STOP Error: UNSUPPORTED DEBUG_MODE in init_probe.cmm first parameter. DEBUG_ON or DEBUG_OFF"
      STOP
   )
)

; No control on &arg_cpu_control value... board depending. But save it
&CPU_CONTROL="&arg_cpu_control"



; prevent path problems
LOCAL &current_dir
&current_dir=OS.PPD()


; According to the target
IF "&CONF_TGT_NAME"=="PROJ_GEN"
(
   IF "&CONF_TGT_MODE"=="TARGET"
   (
      ; Initialize the probe
      DO &current_dir/PROJ_GEN/TGT/init_probe.cmm &arg_debug_mode &arg_cpu_control
   )
   ELSE
   (
      ; Unsupported type
      PRINT "UNSUPPORTED TARGET TYPE : &CONF_TGT_MODE on &CONF_TGT_NAME"
      STOP
   )
)
ELSE IF "&CONF_TGT_NAME"=="FADEX"
(
   IF "&CONF_TGT_MODE"=="TARGET"
   (
      ; Initialize the probe
      DO &current_dir/FADEX/TGT/init_probe.cmm &arg_debug_mode &arg_cpu_control
   )
   ELSE
   (
      ; Unsupported type
      PRINT "UNSUPPORTED TARGET TYPE : &CONF_TGT_MODE on &CONF_TGT_NAME"
      STOP
   )
)
ELSE IF "&CONF_TGT_NAME"=="M88"
(
   IF "&CONF_TGT_MODE"=="TARGET"
   (
      ; Initialize the probe
      DO &current_dir/M88/TGT/init_probe.cmm &arg_debug_mode &arg_cpu_control
   )
   ELSE
   (
      ; Unsupported type
      PRINT "UNSUPPORTED TARGET TYPE : &CONF_TGT_MODE on &CONF_TGT_NAME"
      STOP
   )
)
ELSE IF "&CONF_TGT_NAME"=="COBRA"
(
   IF "&CONF_TGT_MODE"=="TARGET"
   (
      ; Initialize the probe
      DO &current_dir/COBRA/TGT/init_probe.cmm &arg_debug_mode &arg_cpu_control
   )
   ELSE
   (
      ; Unsupported type
      PRINT "UNSUPPORTED TARGET TYPE : &CONF_TGT_MODE on &CONF_TGT_NAME"
      STOP
   )
)
ELSE
(
   ; Unsupported target
   PRINT "UNSUPPORTED TARGET : &CONF_TGT_NAME"
   STOP
)


; End Of Script
ENDDO

