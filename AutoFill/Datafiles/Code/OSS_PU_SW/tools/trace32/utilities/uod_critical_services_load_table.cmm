; ------------------------------------------------------------------------------
;                        SAFRAN Electronics & Defense
;                   Reproduction and disclosure forbidden.
; ------------------------------------------------------------------------------
; DESCRIPTION : Load a table of functions allowing using the UOD CDE3
; ------------------------------------------------------------------------------

; Table header -----------------------------------------------------------------
; Functions number
d.s 0x40060718 %long 2

; Minimum time between 2 functions call (in nanoseconds)
d.s 0x4006071C %long 1000

; Table body -------------------------------------------------------------------
; Function number 1: parameters number (0 or 1)
d.s 0x40060720 %long 0

; Function number 1: function address
d.s 0x40060724 %long 0x01270000

; Function number 1: pointer to possible parameter (0 if none)
d.s 0x40060728 %long 0x0

; Function number 2: parameters number (0 or 1)
d.s 0x4006072C %long 0

; Function number 2: function address
d.s 0x40060730 %long 0x01270000

; Function number 2: pointer to possible parameter (0 if none)
d.s 0x40060734 %long 0x0
