; ------------------------------------------------------------------------------
;                        SAFRAN Electronics & Defense
;                   Reproduction and disclosure forbidden.
; ------------------------------------------------------------------------------
; DESCRIPTION : Unlock the MPC in case of error
; ------------------------------------------------------------------------------

; Reset the configuration of the MPC in T32
SYStem.RESET

; Set the MPC clock
SYStem.BdmClock 4.MHz

; Set CPU
SYStem.cpu MPC5777M

; Set the target core ID to 2
SYStem.CONFIG.CORE 3. 1.

; 
SYSTEM.CONFIG.SLAVE OFF

; 
SYSTEM.OPTION.WATCHDOG OFF

; 
DO ~~/demo/powerpc/etc/standby/haltatpoweronreset.cmm

; Up the system
SYSTEM.UP
