; ------------------------------------------------------------------------------
;                         SAFRAN Electronics & Defense
;                    Reproduction and disclosure forbidden.
; ------------------------------------------------------------------------------
; DESCRIPTION : Finish the boot
; ------------------------------------------------------------------------------
; RSF selection  :
entry &update_rsf_info

; Reset the target
system.resettarget
   
; Go to BOOT_MAIN_ENTRYPOINT_INIT
break.set BOOT_MAIN_ENTRYPOINT_INIT /P
go
wait !(state.run()) 1.
; Disable FLS checks in BOOT if needed :
;Data.Set SD:0x400043D0 %BE %Long 0xBAEBAE
break.delete BOOT_MAIN_ENTRYPOINT_INIT

; Configure MRAM for correct RSF to bypass discrete signals :
if &update_rsf_info==1
(
	; Configure MRAM for g4 :
	do R:/tools/trace32/utilities/oss_conf_mram_default_configuration_g4.cmm
)
if &update_rsf_info==2
(
	; Configure MRAM for g1_2_3 :
	do R:/tools/trace32/utilities/oss_conf_mram_default_configuration_g1_2_3.cmm
)

; Go to BOOT_MC_CHANGE_MODE_INIT
break.set BOOT_MC_CHANGE_MODE_INIT /P
go
wait !(state.run()) 10.
break.delete BOOT_MC_CHANGE_MODE_INIT


; Set breakpoints (first for next step, second for error)
break.set BOOT_RESET_CORE_0 /P
break.set em_raise
break.set em_early_raise

; Step in code till the address of BOOT_RESET_CORE_0 is reached
&b_addr=address.offset(var.address(BOOT_RESET_CORE_0))
&c=0.
wait 0.5

while (register(pc)!=&b_addr)&&(&c<10.)
(
   &c=&c+1.
   step
   wait !(state.run()) 2.
)

; Perform four more steps in front of the C code (and not the assembly)
mode.hll
step
step
step
step

; End the function
enddo