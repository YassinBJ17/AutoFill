; ------------------------------------------------------------------------------
;                         SAFRAN Electronics & Defense
;                    Reproduction and disclosure forbidden.
; ------------------------------------------------------------------------------
; DESCRIPTION : Configure MPC
; ------------------------------------------------------------------------------

; Detect CPU
SYStem.detect.cpu

; Set the target core ID to 0
SYStem.config.core 1. 1.

; Assign the set of physical cores to the system
core.assign 1. 2. 3.

; Set the MPC clock
SYStem.BdmClock 4.MHz
