; ------------------------------------------------------------------------------
;                         SAFRAN Electronics & Defense
;                    Reproduction and disclosure forbidden.
; ------------------------------------------------------------------------------
; DESCRIPTION : Initialize T32
; ------------------------------------------------------------------------------

; Reset all
RESet

; Close all windows
WinCLEAR

; Delete all breakpoints
Break.RESet

; Delete the registered symbols
sYmbol.RESet

; Reset the system configuration
SYStem.RESet

; Clear the message area
AREA.CLEAR

; Display the message area
area.view
