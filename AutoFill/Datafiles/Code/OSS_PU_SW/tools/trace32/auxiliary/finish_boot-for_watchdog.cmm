; ------------------------------------------------------------------------------
;                         SAFRAN Electronics & Defense
;                    Reproduction and disclosure forbidden.
; ------------------------------------------------------------------------------
; DESCRIPTION : Finish the boot for watchdog and powersup
; ------------------------------------------------------------------------------
   
; Reset the target
system.resettarget
   
; Go to BOOT_MC_CHANGE_MODE_INIT
break.set BOOT_MC_CHANGE_MODE_INIT /P
go
wait !(state.run()) 1.
break.delete BOOT_MC_CHANGE_MODE_INIT

; Set breakpoints (first for next step, second for error)
break.set BOOT_RESET_CORE_0 /P
break.set em_raise
break.set em_early_raise


; Step in code till the address of BOOT_RESET_CORE_0 is reached
&b_addr=address.offset(var.address(BOOT_RESET_CORE_0))
&c=0.
wait 0.5
while (register(pc)!=&b_addr)&&(&c<10.)
(
   &c=&c+1.
   step
   wait !(state.run()) 2.
)

; Perform four more steps in front of the C code (and not the assembly)
mode.hll
step
step
step
step

; Windows of variables
WinPOS 3.375 0.78571 89. 28. 0. 0. W005
Var.Watch
VAR.ADDWATCH shmem.s_oss_counter.s_first_power_up_time
VAR.ADDWATCH shmem.s_oss_counter.s_max_tecu_date.s_last_power_up_time
VAR.ADDWATCH shmem.s_oss_counter.s_max_tecu_date.s_power_up_count
VAR.ADDWATCH shmem.s_oss_counter.s_last_power_up_time
VAR.ADDWATCH rtc_counter
VAR.ADDWATCH nb_faulty_rtc_h
VAR.ADDWATCH nb_faulty_rtc_l
VAR.ADDWATCH max_tecu
VAR.ADDWATCH max_tecu_time


; Augmentation à 4sec du temps de grâce INIT WATCHDOG
; Data.Set SD:0x24024014 %BE %Long 0xB5D38F53

; L’adresse de base SIUL2=0xFFFC0000+ offset MSCR=0x240 +offset IO=9C 
; doit passer de 0x32190001 à 0x31190001
; Nous lui demandons de se paramétrer en Open-drain plutôt qu’en Push-pull (p. 804 du référence manuel du MPC)
Data.Set EANC:0xFFFC02DC %BE %Long 0x31190001

; Memory area windows
WinPOS 2.875 35.714 69. 28. 14. 1. W004
Data.dump (0x24024000) /DIALOG

WinPOS 143.75 0.85714 68. 26. 14. 1. W003
Data.dump EANC:0xFFFC02DC /DIALOG

WinPOS 141.25 35.214 80. 23. 24. 1. W000
Data.dump (0x20004600) /DIALOG

WinPOS 77.875 35.857 68. 26. 14. 1. W001
Data.dump v.address("shmem.s_oss_counter_reset") /DIALOG

; Breakpoints list windows
WinPOS 130.75 7.2143 99. 12. 24. 1. W006
WinTABS 13. 0. 0. 0. 0. 0. 0. 0. 0. 47.
; break.set watchdog_init\11

go


; End the function
enddo