; ------------------------------------------------------------------------------
;                         SAFRAN Electronics & Defense
;                    Reproduction and disclosure forbidden.
; ------------------------------------------------------------------------------
; DESCRIPTION : Cancel AS calls
; ------------------------------------------------------------------------------

; Get out of the boot and go to oss_init start :
break.set oss_init /P
go
wait !(state.run()) 1.
break.delete oss_init

; Set the magic key to disable AS calls :
V cancel_as_calls_key = 0xcedaf000

; Information : 
PRINT "[INF] AS calls have been cancelled for this execution (reboot to re-enable them)."

; End the function
enddo
