; ------------------------------------------------------------------------------
;                         SAFRAN Electronics & Defense
;                    Reproduction and disclosure forbidden.
; ------------------------------------------------------------------------------
; DESCRIPTION : Launch the debug
; ------------------------------------------------------------------------------

; Entries :
; flash_mode = 0 : boot / k2 / uod  / g1_2_3 / g4 /
; flash_mode = 1 : boot / k2 /      /        / g4 /
; flash_mode = 2 : boot / k2 /      / g1_2_3 /    /
; flash_mode = 3 : boot /    /      /        /    / 
; flash_mode = 4 : boot /    /      /        /    / as
entry &is_int_src &flash_mode

; Load all filenames and do configuration
do R:/tools/trace32/auxiliary/conf.cmm &is_int_src

; Initialize trace32
do R:/tools/trace32/auxiliary/initialize_t32.cmm

; Prepare the flash
do ~~/demo/powerpc/flash/jpc577xm.cmm prepareonly

; Set the source file path for debug :
do R:/tools/trace32/auxiliary/set_src_path.cmm

; Ask user if flash erasure should be done :
;Flash erasure disabled to avoid rinsing out the OLL !
;do R:/tools/trace32/auxiliary/erase_flash.cmm
flash.reprogram all

; Flash the boot
data.load.s3record "&boot_abs"
data.load.elf "&boot_elf" /STRIPPATH /NOCLEAR /NOCODE

; Flash Asterios (k2)
if (&flash_mode==3)||(&flash_mode==4)
(
	data.load.elf "&k2_elf" /CODESEC /NOCODE /NOCLEAR
)
else
(
	data.load.elf "&k2_elf" /NOCLEAR
)

; Flash the partitions
if (&flash_mode==3)||(&flash_mode==4)
(
	data.load.elf "&parto_oss_css_wrapper_g4_elf" /NOCODE /NOCLEAR
	data.load.elf "&parto_oss_css_wrapper_g1_2_3_elf" /NOCODE /NOCLEAR
)
else
(
	if (&flash_mode==0)||(&flash_mode==1)
	(
		data.load.elf "&parto_oss_css_wrapper_g4_elf" /CODESEC /NOCLEAR
	)
	if (&flash_mode==0)||(&flash_mode==2)
	(
		data.load.elf "&parto_oss_css_wrapper_g1_2_3_elf" /CODESEC /NOCLEAR
	)
)
if (&flash_mode==0)
(
	data.load.elf "&parto_oss_uodg_elf" /CODESEC /NOCLEAR
)
else
(
	data.load.elf "&parto_oss_uodg_elf" /NOCODE /NOCLEAR
)

if (&flash_mode==3)||(&flash_mode==4)
(
	data.load.elf "&error_handler_elf" /NOCODE /NOCLEAR
	data.load.elf "&source_elf"        /NOCODE /NOCLEAR
)
else
(
	data.load.elf "&error_handler_elf" /CODESEC /NOCLEAR
	data.load.elf "&source_elf"        /CODESEC /NOCLEAR
)
; Flash the applications :
if (&flash_mode==3)||(&flash_mode==4)
(
	data.load.elf "&app_css_wrapper_g4_elf" /NOCODE /NOCLEAR
	data.load.elf "&app_css_wrapper_g1_2_3_elf" /NOCODE /NOCLEAR
)
else
(
	if (&flash_mode==0)||(&flash_mode==1)
	(
		data.load.elf "&app_css_wrapper_g4_elf" /CODESEC /NOCLEAR
	)
	if (&flash_mode==0)||(&flash_mode==2)
	(
		data.load.elf "&app_css_wrapper_g1_2_3_elf" /CODESEC /NOCLEAR
	)
)
if (&flash_mode==0)
(
	data.load.elf "&app_uodg_elf" /CODESEC /NOCLEAR
)

; Uncomment the required line to flash the corresponding binaries :
; Do not reflash, just reload :
if (&flash_mode==3)
(
	;data.load.elf  "&css_stub"           /NOCODE /NOCLEAR
	;data.load.elf  "&css_qualification"  /NOCODE /NOCLEAR
	;data.load.elf  "&css_g1_2_3"         /NOCODE /NOCLEAR
	;data.load.elf  "&css_g4"             /NOCODE /NOCLEAR
	;data.load.elf  "&mcss"               /NOCODE /NOCLEAR
	;data.load.elf  "&mcss_qualification" /NOCODE /NOCLEAR
)
; Reflash AS :
if (&flash_mode==4)
(
	;data.load.elf  "&css_stub"           /CODESEC /NOCLEAR
	;data.load.elf  "&css_qualification"  /CODESEC /NOCLEAR
	;data.load.elf  "&css_g1_2_3"         /CODESEC /NOCLEAR
	;data.load.elf  "&css_g4"             /CODESEC /NOCLEAR
	;data.load.elf  "&mcss"               /CODESEC /NOCLEAR
	;data.load.elf  "&mcss_qualification" /CODESEC /NOCLEAR
)


; Flash OSS CONF :
if (&flash_mode==0)||(&flash_mode==1)
(
	data.load.binary "R:/tools/oss_conf_gen_binary/out/OSS_CONF_Definition_Mapping_g4.out" 0x01200000 /NOCLEAR
)
if (&flash_mode==2)
(
	data.load.binary "R:/tools/oss_conf_gen_binary/out/OSS_CONF_Definition_Mapping_g3.out" 0x01200000 /NOCLEAR
)

; End the reprogramming of the flash
flash.reprogram off

; Configure MPC
do R:/tools/trace32/auxiliary/configure_mpc.cmm

; Configure T32 trace
do R:/tools/trace32/auxiliary/configure_trace.cmm

; End the function
enddo
