; ------------------------------------------------------------------------------
;                         SAFRAN Electronics & Defense
;                    Reproduction and disclosure forbidden.
; ------------------------------------------------------------------------------
; DESCRIPTION : Enable debug by setting source file path
; ------------------------------------------------------------------------------

; Set the source file path for debug:
symbol.spath.setrecursedir &src_boot
symbol.spath.setrecursedir &src_oss_pu

; Uncomment the following lines to set the source file path for debug :
;symbol.spath.setrecursedir "R:/specific_binaries/css_stub"
;symbol.spath.setrecursedir "R:/specific_binaries/css_qualification"
;symbol.spath.setrecursedir "R:/specific_binaries/css_g1_2_3"
;symbol.spath.setrecursedir "R:/specific_binaries/css_g4"
;symbol.spath.setrecursedir "R:/specific_binaries/mcss"
;symbol.spath.setrecursedir "R:/specific_binaries/mcss_qualification"

; End the function
enddo
