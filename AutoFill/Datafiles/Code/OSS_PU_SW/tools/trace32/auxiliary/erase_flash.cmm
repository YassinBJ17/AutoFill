; ------------------------------------------------------------------------------
;                         SAFRAN Electronics & Defense
;                    Reproduction and disclosure forbidden.
; ------------------------------------------------------------------------------
; DESCRIPTION : Erase the flash on user request
; ------------------------------------------------------------------------------

; Ask the user if the flash must be erased
dialog.yesno "Erase the flash ?"
local &isEraseRequested
entry &isEraseRequested

do R:/tools/trace32/auxiliary/initialize_t32.cmm

; Prepare the flash
do ~~/demo/powerpc/flash/jpc577xm.cmm prepareonly

; If the flash erasing is requested
if &isEraseRequested
(
   ; Erase the flash
   flash.reprogram all /erase
)
else
(
   ; Reprogram the flash without erasing it
   flash.reprogram all
)

flash.reprogram off
