; ------------------------------------------------------------------------------
;                         SAFRAN Electronics & Defense
;                    Reproduction and disclosure forbidden.
; ------------------------------------------------------------------------------
; DESCRIPTION : Flash or load a binary
; ------------------------------------------------------------------------------

; Parameters
entry &binary &isBinaryToLoadInExecutionArea 

; If the binary to flash is not the kernel
if &isBinaryToLoadInExecutionArea
(
  data.load.elf &binary /CODESEC /NOCLEAR
)
; If the binary to flash is the kernel
else
(
  data.load.elf &binary /NOCLEAR
)

; End the function
enddo
