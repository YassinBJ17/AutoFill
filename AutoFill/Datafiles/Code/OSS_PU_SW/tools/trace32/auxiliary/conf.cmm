; ------------------------------------------------------------------------------
;                         SAFRAN Electronics & Defense
;                    Reproduction and disclosure forbidden.
; ------------------------------------------------------------------------------
; DESCRIPTION : Application / partition / etc to flash/load
; ------------------------------------------------------------------------------

; Entries
entry &is_int_src

GLOBAL &src_boot
GLOBAL &src_oss_pu
GLOBAL &boot_elf
GLOBAL &boot_abs
GLOBAL &k2_elf
GLOBAL &parto_oss_css_wrapper_g1_2_3_elf
GLOBAL &parto_oss_css_wrapper_g4_elf
GLOBAL &parto_oss_uodg_elf
GLOBAL &error_handler_elf
GLOBAL &source_elf
GLOBAL &app_css_wrapper_g1_2_3_elf
GLOBAL &app_css_wrapper_g4_elf
GLOBAL &app_uodg_elf
GLOBAL &css_g1_2_3
GLOBAL &css_g4
GLOBAL &mcss

&src_oss_pu="R:/source"
&k2_elf="R:/specific_binaries/k2/k2.elf"
&css_g1_2_3="R:/specific_binaries/css_g1_2_3/css_g1_2_3.elf"
&css_g4="R:/specific_binaries/css_g4/css_g4.elf"
&mcss="R:/specific_binaries/mcss/mcss.elf"
&error_handler_elf="R:/specific_binaries/error_handler/_build_out/gen/emo_error_handler.elf"

; If internal source
if &is_int_src==1
(
	&parto_oss_css_wrapper_g1_2_3_elf="R:/_build_out/gen/g1_2_3/parto_g1_2_3_oss_int_src.elf"
	&parto_oss_css_wrapper_g4_elf="R:/_build_out/gen/g4/parto_g4_oss_int_src.elf"
	&parto_oss_uodg_elf="R:/_build_out/gen/stub_uod/parto_stub_uod_oss_int_src.elf"
	&source_elf="R:/specific_binaries/int_source/realtime.elf"
	&app_css_wrapper_g1_2_3_elf="R:/_build_out/gen/g1_2_3/app_g1_2_3_oss_int_src.elf"
	&app_css_wrapper_g4_elf="R:/_build_out/gen/g4/app_g4_oss_int_src.elf"
	&app_uodg_elf="R:/_build_out/gen/stub_uod/app_stub_uod_oss_int_src.elf"
)
; If external source
else
(
	&parto_oss_css_wrapper_g1_2_3_elf="R:/_build_out/gen/g1_2_3/parto_g1_2_3_oss_ext_src.elf"
	&parto_oss_css_wrapper_g4_elf="R:/_build_out/gen/g4/parto_g4_oss_ext_src.elf"
	&parto_oss_uodg_elf="R:/_build_out/gen/stub_uod/parto_stub_uod_oss_ext_src.elf"
	&source_elf="R:/specific_binaries/ext_source/_build_out/gen/xt_source.elf"
	&app_css_wrapper_g1_2_3_elf="R:/_build_out/gen/g1_2_3/app_g1_2_3_oss_ext_src.elf"
	&app_css_wrapper_g4_elf="R:/_build_out/gen/g4/app_g4_oss_ext_src.elf"
	&app_uodg_elf="R:/_build_out/gen/stub_uod/app_stub_uod_oss_ext_src.elf"
)

; Load BOOT for CPxB :
&src_boot="R:/specific_binaries/boot/cpxb/Boot_SW/3_Sources/BOOT_code/sources"
&boot_abs="R:/specific_binaries/boot/cpxb/Boot_SW/3_Sources/BOOT_code/build/BOOT.abs"
&boot_elf="R:/specific_binaries/boot/cpxb/Boot_SW/3_Sources/BOOT_code/build/BOOT.elf"

; End the function
enddo
