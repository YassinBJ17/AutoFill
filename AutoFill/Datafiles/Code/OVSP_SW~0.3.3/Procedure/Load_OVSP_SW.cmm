AREA.View
AREA.Clear

PRINT " ----------------------------------------------------------------------------- "
PRINT "                Load_OVSP_SW: Load the OVSP Software in S32K144                "
PRINT " ----------------------------------------------------------------------------- " 
PRINT ""

RESET

; -----------------------------------------------------------------------------
;                   Init Local Variables
; -----------------------------------------------------------------------------

LOCAL &current_dir

; Initialize local variables
&current_dir=OS.PPD()

PRINT " 1/ T32 environnement initialization"
PRINT ""

; Force directory
CD "&current_dir"
PRINT ""

TOOLBAR ON
STATUSBAR ON
BREAK.RESET
MODE.HLL

PRINT " 2/ Import T32 global configuration"
PRINT ""

; make sure we use hexadecimal values by default
RADIX.HEX

; Declare global
GLOBAL &CONF_TGT_NAME
GLOBAL &CONF_TGT_EXE
GLOBAL &CONF_TGT_MODE
GLOBAL &CONF_ETM_PROBE

;-------------------------;
; CONF_TGT_EXE
;-------------------------;
&CONF_TGT_EXE="t32marm"

;-------------------------;
; CONF_TGT_NAME
;-------------------------;
&CONF_TGT_NAME="S32K144"

;-------------------------;
; CONF_TGT_MODE
;-------------------------;
&CONF_TGT_MODE="TARGET"

;-------------------------;
; CONF_ETM_PROBE
;-------------------------;
&CONF_ETM_PROBE="DISABLED"

PRINT " 3/ Configure Trace 32 CPU environnement and Probe configuration"
PRINT ""

SYSTEM.RESET
SYSTEM.JTAGCLOCK 10MHz

SYStem.Option TRST on
SYStem.Option ResBreak on
SYStem.Option WaitReset ON

SYStem.CPU S32K144

SYSTEM.MEMACCESS DENIED    ;Default : DENIED
SYSTEM.CPUACCESS DENIED    ;Default : DENIED
SYSTEM.OPTION IMASKASM OFF ;Default : OFF
SYSTEM.OPTION IMASKHLL OFF ;Default : OFF

; SYSTEM is now UP
SYSTEM.ResetTarget
SYSTEM.UP
PRINT ""

PRINT " 4/ S32K144 Watchdog and Bootrom Disabling for safety in FLASH loading"
PRINT ""

GOSUB DisableBootrom
GOSUB DisableWatchdog

PRINT " 5/ RAM initialization"
PRINT ""

DATA.SET 0X1FFF8000--0X20007FFF %Quad 0

;Clear the symbol list if this list already exists
SYMBOL.RESET
SYMBOL.SPATH.RESET

PRINT " 6/ Load OVSP_SW"
PRINT ""

RESET

&PFlashSize=0x80000
&DFlashSize=0x10000

FLASH.Create 1. 0x00000000--0x0007EFFF 0x1000 TARGET Quad
FLASH.Create 4. 0x1000FC00--0x1000FFFF 0x400 TARGET Quad ; Plage de flash du Logbook en DFLASH
FLASH.TARGET 0x1FFFF000 0x20000000 0x1000 ~~/demo/arm/flash/quad/s32k_4k2k.bin

SYStem.RESetTarget

WAIT 1.

FLASH.auto 1.

DATA.SET 0x0--0x7EFFF %Quad 0x0

Data.LOAD.binary ..\EOC\OVSP_SW.lup 0x0
PRINT ""

PRINT " 7/ Zeroise Logbook Area in FlexNVM"
PRINT ""

FLASH.auto 4.
Data.Set 0x1000FC00--0x1000FFFF %Quad 0x0 

FLASH.auto.off

IF !SYStem.Option.DUALPORT()
   SYStem.Option.DUALPORT ON

PRINT %COLOR.GREEN "OVSP_SW Loaded successfully"
DIALOG.MESSAGE "OVSP_SW Loaded successfully"

DO Read_Cartridge
DO Read_EOC_32-bit_CRC

ENDDO

DisableWatchdog:
  LOCAL &tmp1 &tmp2
  &tmp1=Data.Long(ST:0x20000000)
  &tmp2=Data.Long(ST:0x20000004)

  ; The watchdog has a restrictive timing. It has to be configured and unlocked within a peripod
  ; of 128 cycles. Therefor the unlock sequence need to be done by a small target program.
  Data.Assemble ST:0x20000000  strh r1,[r0]  ;SD:0x40052004 = 0xC520   (Key 1)
  Data.Assemble ,              strh r2,[r0]  ;SD:0x40052004 = 0xD928   (Key 2)
  Data.Assemble ,              strh r4,[r3]  ;SD:0x40052000 = 0x0000   (Config register)
  Data.Assemble ,              bkpt #0
  Register.Set PC 0x20000000
  Register.Set SP 0x20001000
  Register.Set R0 0x40052004
  Register.Set R1 0xC520
  Register.Set R2 0xD928
  Register.Set R3 0x40052000
  Register.Set R4 0x0
  Go.direct
  WAIT !RUN()

  Data.Set ST:0x20000000 %Long &tmp1
  Data.Set ST:0x20000004 %Long &tmp2

  RETURN

DisableBootrom:
  Data.Set SD:0x4007F010 %LE %Long 0x6
  Data.Set SD:0x4007F014 %LE %Long 0x0
  RETURN
